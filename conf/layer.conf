## conf/layer.conf
```bitbake
# We have a conf and classes directory, add to BBPATH
BBPATH .= ":${LAYERDIR}"

# We have a recipes directory, add to BBFILES
BBFILES += "${LAYERDIR}/*/*.bb \
	${LAYERDIR}/*/*.bbappend"

BBFILE_COLLECTIONS += "nickdademo"
BBFILE_PATTERN_nickdademo := "^${LAYERDIR}/"
BBFILE_PRIORITY_nickdademo = "7"
```
